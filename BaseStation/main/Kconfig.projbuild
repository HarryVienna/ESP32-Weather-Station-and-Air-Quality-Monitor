## BaseStation/main/Kconfig.projbuild
```kconfig
menu "Weather Station Display Board"

    choice DISPLAY_BOARD
        prompt "Display board"
        default DISPLAY_BOARD_WAVESHARE
        help
            Selects which of main/display/display_waveshare.c /
            display_guition.c actually compiles to anything (the other's
            content is compiled out via #if, see the top of each file) -
            both sit in the tree at once, but only the selected board's
            driver is built and linked.

            The two boards use different touch controllers, backlight
            mechanisms, GPIOs, and JD9365 panel init sequences, so exactly
            one must be picked here at build time - not auto-detected at
            boot, since probing wrong and configuring the wrong board's
            GPIOs as outputs/inputs is a real risk (they mean something
            else, or are unconnected, on the other board).

        config DISPLAY_BOARD_WAVESHARE
            bool "Waveshare ESP32-P4-Module-DEV-KIT (GT911 touch, I2C backlight)"

        config DISPLAY_BOARD_GUITION
            bool "Guition JC8012P4A1C-I-W-Y (GSL3680 touch, PWM backlight)"

    endchoice

endmenu
```

## Sensor-ESP-NOW-BME280/sdkconfig.defaults
```kconfig
# Target chip
CONFIG_IDF_TARGET="esp32"

# No reboot after panic
CONFIG_ESP_SYSTEM_PANIC_PRINT_HALT=y

# ESP32-specific: 80 MHz sufficient for I2C/SPI/ADC — saves ~40 mA vs 240 MHz
CONFIG_ESP32_TIME_SYSCALL_USE_RTC_FRC1=y
CONFIG_ESP32_RTC_CLK_SRC_INT_RC=y
CONFIG_ESP32_DEFAULT_CPU_FREQ_80=y
CONFIG_ESP32_DEFAULT_CPU_FREQ_MHZ=80

CONFIG_ESPTOOLPY_FLASHSIZE_DETECT=n
CONFIG_ESPTOOLPY_FLASHSIZE_8MB=y
CONFIG_ESPTOOLPY_FLASHMODE_QIO=y
CONFIG_ESPTOOLPY_FLASHFREQ_80M=y


# Skip firmware SHA256 validation on deep-sleep wake
CONFIG_BOOTLOADER_SKIP_VALIDATE_IN_DEEP_SLEEP=y
CONFIG_BOOTLOADER_SKIP_VALIDATE_ON_POWER_ON=y
CONFIG_BOOTLOADER_SKIP_VALIDATE_ALWAYS=y

CONFIG_BOOTLOADER_LOG_LEVEL_NONE=y
CONFIG_BOOTLOADER_LOG_LEVEL=0
#CONFIG_BOOT_ROM_LOG_ALWAYS_OFF=y

CONFIG_ESP_PHY_CALIBRATION_AND_DATA_STORAGE=y
CONFIG_ESP_PHY_CALIBRATION_MODE=1

CONFIG_FREERTOS_UNICORE=y
CONFIG_FREERTOS_HZ=1000

CONFIG_LOG_DEFAULT_LEVEL_NONE=y
CONFIG_BOOTLOADER_LOG_LEVEL_NONE=y
```
